#include "M5Atom.h"
#include "millisDelay.h"
#include <Adafruit_GFX.h>
#include <Adafruit_NeoMatrix.h>
#include <Adafruit_NeoPixel.h>

/* Set up text display*/
#define PIN 27

Adafruit_NeoMatrix matrix = Adafruit_NeoMatrix(5, 5, PIN,
  NEO_MATRIX_TOP     + NEO_MATRIX_LEFT +
  NEO_MATRIX_ROWS + NEO_MATRIX_PROGRESSIVE,
  NEO_GRB            + NEO_KHZ800);

/* Text variables */
/* text vars */
const uint16_t textWhite = matrix.Color(255, 255, 255);
int x    = matrix.width();
int pass = 0;

/*variable declaration*/
float tempVal;
float minVal[1440] = {42, 27, 39, 50, 30, 38, 42, 20, 4, 27, 11, 46, 35,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 48, 19};
float hourVal[24];
int minCtr;
int hourCtr;
int dayCtr;
int minAvg = 0;
int hourAvg = 0;
int dayAvg = 0;
int minSum = 0;
millisDelay ReadDelay;
int interval = 60000;

/*temp color values*/
const uint32_t blue = 0x0000ff;
const uint32_t green = 0x00ff00;
const uint32_t yellow = 0xffff00;
const uint32_t red = 0x00ff00;
uint32_t curColor; 

void minToHour(){
  int hCtr = 0;
  int hourCount = (sizeof(minVal)/sizeof(int)) / 60;
  while(hCtr < hourCount){
    int mCtr = hCtr * 60;
    int mEnd = mCtr + 60;
    while(mCtr < mEnd){
      minSum += minVal[mCtr];
      mCtr++;
    }
    hourVal[hCtr] = minSum / 60;
    hCtr++;
    minSum = 0;
  }
}

void displayGraph(){
  for(int gCtr = 0; gCtr < 24; gCtr++){
    Serial.println(hourVal[gCtr]);
    curColor = tempColorSelect(hourVal[gCtr]);
    colorPixel(gCtr, curColor);
  }
}

uint32_t tempColorSelect(float tempVal){
  uint32_t color;
  if(tempVal < 15){
    color = blue;
  }else if (tempVal < 30){
    color = green;
  }else if (tempVal < 35){
    color = yellow;
  }else{
    color = red;
  }
  return(color);
}

void colorPixel(int pixel,uint32_t color){
   matrix.setPixelColor(pixel, color);
}

void setup() {
  M5.begin(true,false, true);
  M5.IMU.Init();
  matrix.clear();
  Serial.begin(115200);
  Serial.println("Temperature Data");
  ReadDelay.start(interval);
}

void loop() {
  minToHour();  
  displayGraph();
  matrix.show();
  M5.update();  
}
